## drivers/mmlog/Kconfig
```kconfig
menuconfig MICRON_MEMORY_LOG
	tristate "Micron EBU Memory log tool support"
	default n
	help
	  This is to support Micron EBU software team developed
	  Memory log tool for printing message to RAM.
```

## drivers/mtd/spi-nand/Kconfig
```kconfig
menuconfig MTD_SPI_NAND
	tristate "SPI-NAND device Support"
	depends on MTD_NAND_BBT && SPI
	help
	  This is the framework for the SPI NAND which can be used by the SPI
	  device drivers and the SPI-NAND device drivers.

if MTD_SPI_NAND

config SPI_NAND_USE_SPI_NOR_RD_PROT
	bool "Use SPI NOR flash 03h/0bh read protocol"
	default n
	help
	  Micron M79A SPI NAND support implement 03h/0Bh command, as is done
	  with SPI NOR for compatibility.

endif # MTD_SPI_NAND
```
